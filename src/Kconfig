## src/Kconfig
```kconfig
mainmenu "embedded controller configuration"

menu "General setup"

config LOCALVERSION
	string "Local version string"
	help
	  Append an extra string to the end of the EC version.

	  This can be useful if, for instance, you want to append the
	  respective board's hostname or some other identifying string to
	  the coreboot version number, so that you can easily distinguish
	  boot logs of different boards from each other.

choice
	prompt "Compiler to use"
	default COMPILER_GCC
	help
	  This option allows you to select the compiler used for building
	  coreboot.

config COMPILER_GCC
	bool "GCC"
	help
	  Use the GNU Compiler Collection (GCC) to build coreboot.

	  For details see http://gcc.gnu.org.

config COMPILER_LLVM_CLANG
	bool "LLVM/clang"
	help
	  Use LLVM/clang to build coreboot.

	  For details see http://clang.llvm.org.

endchoice

endmenu

# board -> chip -> core (ISA)
source src/board/Kconfig

# This option is used to set the architecture ISA of the EC.
# It is usually set in src/board/*/Kconfig.
config CORE_CORETEX-M
	bool
	default n
config CORE_CORETEX-M
	bool
	default n
config CORE_HOST
	bool
	default n
config CORE_NDS32
	bool
	default n
config CORE_8051
	bool
	default n

#source src/core/cortex-m/Kconfig
#source src/core/cortex-m0/Kconfig
#source src/core/host/Kconfig
#source src/core/nds32/Kconfig
#source src/core/8051/Kconfig

source src/common/Kconfig

source src/power/Kconfig

menu "Generic Drivers"
source src/driver/Kconfig
endmenu

# source src/mainboard/Kconfig
```

## src/board/Kconfig
```kconfig
menu "Mainboard"

choice
	prompt "Board vendor"
	default VENDOR_GOOGLE

config VENDOR_GOOGLE
	bool "Google"

endchoice

source "src/board/google/Kconfig"

config BOARD_ROMSIZE_KB_64
	bool
config BOARD_ROMSIZE_KB_128
	bool
config BOARD_ROMSIZE_KB_256
	bool
config BOARD_ROMSIZE_KB_512
	bool
config BOARD_ROMSIZE_KB_1024
	bool

# Map the config names to a hex value (bytes).
config ROM_SIZE
	hex
	default 0x10000 if COREBOOT_ROMSIZE_KB_64
	default 0x20000 if COREBOOT_ROMSIZE_KB_128
	default 0x40000 if COREBOOT_ROMSIZE_KB_256
	default 0x80000 if COREBOOT_ROMSIZE_KB_512
	default 0x100000 if COREBOOT_ROMSIZE_KB_1024

config BOARD_SERIAL_NUMBER
	string "EC Serial Number"
	default "123456789"
        help
	  The Serial Number to store in the EC EEPROM.

config BOARD_VERSION
	string "EC Version Number"
	default "1.0"
	help
	  The Version Number to store in the EC EEPROM.

config BOARD_MANUFACTURER
	string "EC Manufacturer"
	default BOARD_VENDOR
	help
	  Override the default Manufacturer stored in the EC EEPROM.

config BOARD_PRODUCT_NAME
	string "EC Product name"
	default BOARD_PART_NUMBER
	help
	  Override the default Product name stored in the EC EEPROM.

endmenu
```

## src/board/google/Kconfig
```kconfig
if VENDOR_GOOGLE

choice
	prompt "Mainboard model"

config BOARD_GOOGLE_LINK
	bool "Link"

endchoice

source "src/board/google/link/Kconfig"

config MAINBOARD_VENDOR
	string
	default "Google"

endif # VENDOR_GOOGLE
```

## src/board/google/link/Kconfig
```kconfig
if BOARD_GOOGLE_LINK

config BOARD_SPECIFIC_OPTIONS # dummy
	def_bool y
	select CPU_LM4 # the IC is TI Stellaris LM4
# ################# #
# Optional features #
# ################# #
#	select AP_HANG_DETECT
#	select BACKLIGHT_LID
#	select BACKLIGHT_REQ_GPIO GPIO_PCH_BKLTEN
#	select BATTERY_LINK
#	select BATTERY_SMART
#	select BATTERY_OVERRIDE_PARAMS
#	select BOARD_VERSION
#	select CHARGER
#	select CHARGER_V1
#	select CHARGER_BQ24725
#	select CHIPSET_CAN_THROTTLE
#	select CHIPSET_IVYBRIDGE
#	select POWER_COMMON
#	select EXTPOWER_GPIO
#	select I2C_PASSTHRU_RESTRICTED
#	select KEYBOARD_BOARD_CONFIG
#	select KEYBOARD_PROTOCOL_8042
#	select LED_DRIVER_DS2413
#	select ONEWIRE
#	select POWER_BUTTON
#	select POWER_BUTTON_X86
#	select PWM
#	select PWM_KBLIGHT
#	select SWITCH_DEDICATED_RECOVERY
#	select TEMP_SENSOR
#	select TEMP_SENSOR_POWER_GPIO GPIO_PGOOD_1_8VS
#	select TEMP_SENSOR_TMP006
#	select USB_PORT_POWER_SMART
#	select VBOOT_HASH
#	select WIRELESS
#	select WP_ACTIVE_HIGH
#
#config BOARD_DIR
#	string
#	default google/link
#
#config BOARD_PART_NUMBER
#	string
#	default "Link"
#
#config FANS
#	bool
#	default y
#
#config PECI_TJMAX
#	int
#	default 105
#
#config UART_HOST
#	bool
#	default y

endif # BOARD_GOOGLE_LINK
```

## src/chip/Kconfig
```kconfig
# FIXME!!! Make sure chips depend on the correct core??

config CHIP_HOST
	bool
	depends on CORE_HOST
	default n

config CHIP_IT83XX
	bool
	depends on CORE_CORETEX-M
	default n

config CHIP_LM4
	bool
	depends on CORE_CORETEX-M
	default n

config CHIP_MEC1322
	bool
	depends on CORE_CORETEX-M
	default n

config CHIP_STM32
	bool
	depends on CORE_CORETEX-M
	default n

# FIXME: make chip config headers into Kconfig mubojumbo
#source src/chip/host/Kconfig
#source src/chip/it83xx/Kconfig
#source src/chip/lm4/Kconfig
#source src/chip/mec1322/Kconfig
#source src/chip/stm32/Kconfig
```

## src/common/Kconfig
```kconfig
config ACCEL_CALIBRATE
	bool
	default n

config ADC
	bool
	default n

config ALS
	bool
	default n

config AP_HANG_DETECT
	bool
	default n

config BACKLIGHT_LID
	bool
	default n

config BATTERY_BQ27541
	bool
	default n

config BATTERY_SMART
	bool
	default n

config BUTTON_COUNT
	bool
	default n

config CAPSENSE
	bool
	default n

config CHARGER
	bool
	default n

config CHARGER_V1
	bool
	default n

config CHARGER_V2
	bool
	default n

config CHARGER_TPS65090
	bool
	default n

config CMD_I2CWEDGE
	bool
	default n

config COMMON_GPIO
	bool
	default n

config COMMON_PANIC_OUTPUT
	bool
	default n

config COMMON_RUNTIME
	bool
	default n

config COMMON_TIMER
	bool
	default n

config PMU_POWERINFO
	bool
	default n

config PMU_TPS65090
	bool
	default n

config EOPTION
	bool
	default n

config EXTPOWER_FALCO
	bool
	default n

config EXTPOWER_GPIO
	bool
	default n

config EXTPOWER_SNOW
	bool
	default n

config EXTPOWER_SPRING
	bool
	default n

config FANS
	bool
	default n

config FLASH
	bool
	default n

config FMAP
	bool
	default n

config I2C
	bool
	default n

config I2C_ARBITRATION
	bool
	default n

config KEYBOARD_PROTOCOL_8042
	bool
	default n

config KEYBOARD_PROTOCOL_MKBP
	bool
	default n

config KEYBOARD_TEST
	bool
	default n

config LED_COMMON
	bool
	default n

config LID_ANGLE_KEY_SCAN
	bool
	default n

config LID_SWITCH
	bool
	default n

config LPC
	bool
	default n

config ONEWIRE
	bool
	default n

config POWER_BUTTON
	bool
	default n

config POWER_BUTTON_X86
	bool
	default n

config PSTORE
	bool
	default n

config PWM
	bool
	default n

config PWM_KBLIGHT
	bool
	default n

config SHA1
	bool
	default n

config SOFTWARE_CLZ
	bool
	default n

config SWITCH
	bool
	default n

config TEMP_SENSOR
	bool
	default n

config USB_PORT_POWER_DUMB
	bool
	default n

config USB_PORT_POWER_SMART
	bool
	default n

config USB_POWER_DELIVERY
	bool
	default n

config VBOOT_HASH
	bool
	default n

config WIRELESS
	bool
	default n
```

## src/core/Kconfig
```kconfig
# This option is used to set the architecture ISA of the EC.
# It is usually set in src/board/*/Kconfig.
config CORE_CORETEX-M
	bool
	default n
config CORE_CORETEX-M0
	bool
	default n
config CORE_HOST
	bool
	default n
config CORE_NDS32
	bool
	default n
config CORE_8051
	bool
	default n

#source src/core/cortex-m/Kconfig
#source src/core/cortex-m0/Kconfig
#source src/core/host/Kconfig
#source src/core/nds32/Kconfig
#source src/core/8051/Kconfig
```

## src/driver/Kconfig
```kconfig
menu "Misc Drivers"
source src/driver/misc/Kconfig
endmenu

menu "Battery Drivers"
source src/driver/battery/Kconfig
endmenu

menu "Charger Drivers"
source src/driver/charger/Kconfig
endmenu

menu "LED Drivers"
source src/driver/led/Kconfig
endmenu

menu "Power Monitor Drivers"
source src/driver/power_mon/Kconfig
endmenu

menu "Tempature Sensor Drivers"
source src/driver/temp_sensor/Kconfig
endmenu

menu "USB Switch Drivers"
source src/driver/usb/Kconfig
endmenu
```

## src/driver/misc/Kconfig
```kconfig
# Accelerometers
config ACCEL_KXCJ9
	bool "Support for KXCJ9 Accelerometer driver"
	default n

# ALS drivers
config ALS_ISL29035
	bool "Support for ALS ISL29035 driver"
	default n

# Voltage regulators
config REGULATOR_IR357X
	bool "Support for ir357x voltage regulator driver"
	default n
```

## src/driver/power_mon/Kconfig
```kconfig
# Current/Power monitor
config INA231
	bool "Support for ina231 current/power monitor driver"
	default n
```

## src/driver/temp_sensor/Kconfig
```kconfig
# Temperature sensors

config TEMP_SENSOR_G781
	bool "Support for G781 Temperature sensor driver"
	default n

config TEMP_SENSOR_TMP006
	bool "Support for TMP006 Temperature sensor driver"
	default n

config TEMP_SENSOR_TMP432
	bool "Support for TMP432 Temperature sensor driver"
	default n
```

## src/driver/usb/Kconfig
```kconfig
# USB switches
config USB_SWITCH_TSU6721
	bool "Support for tsu6721 usb switche driver"
	default n
```

## src/drivers/Kconfig
```kconfig
menu "Misc Drivers"
source src/drivers/misc/Kconfig
endmenu

menu "Battery Drivers"
source src/drivers/battery/Kconfig
endmenu

menu "Charger Drivers"
source src/drivers/charger/Kconfig
endmenu

menu "LED Drivers"
source src/drivers/led/Kconfig
endmenu

menu "Power Monitor Drivers"
source src/drivers/power_mon/Kconfig
endmenu

menu "Tempature Sensor Drivers"
source src/drivers/temp_sensor/Kconfig
endmenu

menu "USB Switch Drivers"
source src/drivers/usb/Kconfig
endmenu
```

## src/drivers/battery/Kconfig
```kconfig
# Batteries

config BATTERY_BQ20Z453
	bool "Support for BQ20Z453 Battery"
	default n
	help
	  Enable support for BQ20Z453 Battery

config BATTERY_BQ27541
	bool "Support for BQ27541 Battery"
	default n
	help
	  Enable support for BQ27541 Battery

config BATTERY_LINK
	bool "Support for Link Battery"
	default n
	help
	  Enable support for Link Battery

config BATTERY_SAMUS
	bool "Support for Samus Battery"
	default n
	help
	  Enable support for Samus Battery

config BATTERY_SMART
	bool "Support for Smart Battery"
	default n
	help
	  Enable support for Smart Battery
```

## src/drivers/charger/Kconfig
```kconfig
# Battery charger ICs

config CHARGER_BQ24192
	bool "Support for BQ24192 Charger"
	default n
	help
	  Enable support for BQ24192 Charger

config CHARGER_BQ24707A
	bool "Support for BQ24707A Charger"
	default n
	help
	  Enable support for BQ24707A Charger

config CHARGER_BQ24715
	bool "Support for BQ24715 Charger"
	default n
	help
	  Enable support for BQ24715 Charger

config CHARGER_BQ24725
	bool "Support for BQ24725 Charger"
	default n
	help
	  Enable support for BQ24725 Charger

config CHARGER_BQ24735
	bool "Support for BQ24735 Charger"
	default n
	help
	  Enable support for BQ24735 Charger

config CHARGER_BQ24738
	bool "Support for BQ24738 Charger"
	default n
	help
	  Enable support for BQ24738 Charger

config CHARGER_BQ24773
	bool "Support for BQ24773 Charger"
	default n
	help
	  Enable support for BQ24773 Charger
```

## src/drivers/led/Kconfig
```kconfig
# LED drivers

config LED_DRIVER_DS2413
	bool "Support for DS2413 LED driver"
	default n
	help
	  Enable support for DS2413 LED driver

config LED_DRIVER_LP5562
	bool "Support for LP5562 LED driver"
	default n
	help
	  Enable support for LP5562 LED driver
```

## src/power/Kconfig
```kconfig
config CHIPSET_BAYTRAIL
	bool
	default n

config CHIPSET_GAIA
	bool
	default n

config CHIPSET_HASWELL
	bool
	default n

config CHIPSET_IVYBRIDGE
	bool
	default n

config CHIPSET_TEGRA
	bool
	default n

config POWER_COMMON
	bool
	default n
```
